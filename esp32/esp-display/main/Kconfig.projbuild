## esp32/esp-display/main/Kconfig.projbuild
```kconfig
menu "Photo Frame"

    config FRAME_WIFI_SSID
        string "Wi-Fi SSID"
        default ""

    config FRAME_WIFI_PASSWORD
        string "Wi-Fi password"
        default ""

    config FRAME_PHOTOS_URL
        string "Photo directory URL (nginx JSON autoindex, trailing slash)"
        default "http://192.168.1.18:8080/photos/"

    config FRAME_IMAGES_URL
        string "Image URL prefix (imgproxy; the file name and @jpg are appended)"
        default "http://192.168.1.18:8081/insecure/rs:fit:800:480/plain/"

    config FRAME_INTERVAL_SEC
        int "Seconds between photos"
        default 600

endmenu
```
